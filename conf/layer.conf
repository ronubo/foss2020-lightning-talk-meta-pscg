## conf/layer.conf
```bitbake
# We have a conf and classes directory, add to BBPATH
BBPATH .= ":${LAYERDIR}"

# We have recipes-* directories, add to BBFILES
BBFILES += "${LAYERDIR}/recipes-*/*/*.bb \
	${LAYERDIR}/recipes-*/*/*.bbappend"

BBFILE_COLLECTIONS += "pscg"
BBFILE_PATTERN_pscg = "^${LAYERDIR}/"
BBFILE_PRIORITY_pscg = "9"
LAYERVERSION_pscg = "0.1"
LAYERSERIES_COMPAT_pscg = "warrior zeus dunfell gatesgarth ronronronronron"
```
